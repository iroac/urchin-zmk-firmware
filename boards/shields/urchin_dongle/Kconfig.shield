## boards/shields/urchin_dongle/Kconfig.shield
```kconfig
# Copyright (c) 2026 The ZMK Contributors
# SPDX-License-Identifier: MIT

config SHIELD_URCHIN_DONGLE
    def_bool $(shields_list_contains,urchin_dongle)
```
